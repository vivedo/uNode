## sdkconfig.defaults
```kconfig
# Set flash size to 1MB for the ESP01
CONFIG_ESPTOOLPY_FLASHSIZE_1MB=y

# Increase (default 512) HTTPD header max length as some browsers send lots of junk in headers
CONFIG_HTTPD_MAX_REQ_HDR_LEN=1024

# Debug level
# CONFIG_LOG_DEFAULT_LEVEL_NONE is not set
# CONFIG_LOG_DEFAULT_LEVEL_ERROR is not set
# CONFIG_LOG_DEFAULT_LEVEL_WARN is not set
# CONFIG_LOG_DEFAULT_LEVEL_INFO is not set
CONFIG_LOG_DEFAULT_LEVEL_DEBUG=y
# CONFIG_LOG_DEFAULT_LEVEL_VERBOSE is not set

CONFIG_LWIP_HIGH_THROUGHPUT=y

# CONFIG_ESP8266_DEFAULT_CPU_FREQ_80 is not set
CONFIG_ESP8266_DEFAULT_CPU_FREQ_160=y


CONFIG_PARTITION_TABLE_SINGLE_APP=y
# CONFIG_PARTITION_TABLE_TWO_OTA is not set
# CONFIG_PARTITION_TABLE_CUSTOM is not set
# CONFIG_PARTITION_TABLE_CUSTOM_FILENAME="partitions.csv"
```
